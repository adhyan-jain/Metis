## research/metis_exidx/work/hello_sw/Kconfig/boards/Kconfig.sysbuild
```kconfig
# Load Sysbuild board Kconfig descriptions.
osource "/home/adhyan/Desktop/Compiler/corpora/zephyr/boards/arm/mps2/Kconfig.sysbuild"
```

## research/metis_llext/work/bundle_slid/Kconfig/arch/Kconfig
```kconfig
# Load Zephyr Arch Kconfig descriptions.
osource "/home/adhyan/Desktop/Compiler/corpora/zephyr/arch/hexagon/Kconfig"
osource "/home/adhyan/Desktop/Compiler/corpora/zephyr/arch/rx/Kconfig"
osource "/home/adhyan/Desktop/Compiler/corpora/zephyr/arch/x86/Kconfig"
osource "/home/adhyan/Desktop/Compiler/corpora/zephyr/arch/xtensa/Kconfig"
osource "/home/adhyan/Desktop/Compiler/corpora/zephyr/arch/sparc/Kconfig"
osource "/home/adhyan/Desktop/Compiler/corpora/zephyr/arch/riscv/Kconfig"
osource "/home/adhyan/Desktop/Compiler/corpora/zephyr/arch/posix/Kconfig"
osource "/home/adhyan/Desktop/Compiler/corpora/zephyr/arch/openrisc/Kconfig"
osource "/home/adhyan/Desktop/Compiler/corpora/zephyr/arch/mips/Kconfig"
osource "/home/adhyan/Desktop/Compiler/corpora/zephyr/arch/arm64/Kconfig"
osource "/home/adhyan/Desktop/Compiler/corpora/zephyr/arch/arm/Kconfig"
osource "/home/adhyan/Desktop/Compiler/corpora/zephyr/arch/arc/Kconfig"
```

## research/metis_llext/work/bundle_slid/Kconfig/boards/Kconfig.defconfig
```kconfig
# Load Zephyr board defconfig descriptions.
osource "/home/adhyan/Desktop/Compiler/corpora/zephyr/boards/arm/mps2/Kconfig.defconfig"
```
